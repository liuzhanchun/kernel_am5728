## src/Documentation/devicetree/bindings/iio/dac/ad5724r.txt
```
Analog Devices AD5724/AD5734/AD5754 DAC device driver

Required properties:
	- compatible: Must be one of "adi,ad5724r", "adi,ad5734r", "adi,ad5754r"
	- reg: SPI chip select number for the device
	- spi-max-frequency: Max SPI frequency to use (< 30000000)
	- spi-cpha: Must have this one

Example:

		ad5724@0 {
			compatible = "adi,ad5724r";
			reg = <1>; /* CS1 */
			spi-cpha; /* SPI_MODE_1 */
			spi-max-frequency = <15000000>;
		};
```

## src/Documentation/devicetree/bindings/media/i2c/tvp5158.txt
```
* Texas Instruments TVP5158 video decoder

The TVP5158 device is high quality, single-chip
digital video decoder that digitizes and decodes all popular baseband analog
video formats into digital video component. The tvp5158 decoder supports
decoding of NTSC, PAL and SECAM composite and S-video.

TVP5158 generates output in BT656 format with embedded sync.

Required Properties :
- compatible : Must be "ti,tvp5158"
- channels   : The channel information of tvp5158,four channels should be "channels = <0 2 4 6>;"
Optional Properties :
  There are no custom optional properties although the driver supports
  standard endpoint properties as documented in
  Documentation/devicetree/bindings/media/video-interfaces.txt

Example:

	&i2c2 {
		...
		...
		tvp5158@5c {
			compatible = "ti,tvp5158";
			reg = <0x58>;

			port {
				tvp_decoder: endpoint {
					channels = <0 2 4 6>;
				};
			};
		};
		...
	};
```

## src/drivers/media/spi/Kconfig
```kconfig
if VIDEO_V4L2

menu "SPI helper chips"
	visible if !MEDIA_SUBDRV_AUTOSELECT || COMPILE_TEST

config VIDEO_GV7601
	tristate "Gennum Serializers video GV7601"
	depends on SPI && VIDEO_V4L2 && VIDEO_V4L2_SUBDEV_API
	---help---
	  Enable the GV7601 driver which serializes video streams.

endmenu

endif
```
